## config/west.yml
```yaml
manifest:
  remotes:
  - name: zmkfirmware
    url-base: https://github.com/zmkfirmware
  projects:
  - name: zmk
    remote: zmkfirmware
    revision: v0.3
    import: app/west.yml
  - name: zmk-keyboards-totem
    url: https://github.com/victorlucachi/zmk-keyboards-totem
    revision: 6b76bfbc5356cb5d93fc2d64acf44608bfc50187
    path: modules/zmk-keyboards-totem
  self:
    path: config
```

## dts/bindings/behaviors/zmk,behavior-os-mode.yaml
```yaml
description: Toggle the OS-aware key mapping mode
compatible: "zmk,behavior-os-mode"
include: zero_param.yaml
```
